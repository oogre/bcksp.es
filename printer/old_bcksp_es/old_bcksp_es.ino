/*
  RECTO
  ........................................|........................................
  ................bcksp.es................|..............Introduction..............
  ........................................|........................................
  .....******************************.....|.....******************************.....
  .....******************************.....|.....******************************.....
  .....******************************.....|.....******************************.....
  .....******************************.....|.....******************************.....
  .....******************************.....|.....******************************.....
  .....******************************.....|.....******************************.....
  .....******************************.....|.....******************************.....
  .....******************************.....|.....******************************.....
  .....******************************.....|.....******************************.....
  .....******************************.....|.....******************************.....
  .....******************************.....|.....******************************.....
  .....******************************.....|.....******************************.....
  .....******************************.....|.....******************************.....
  .....******************************.....|.....******************************.....
  .....******************************.....|.....******************************.....
  .....******************************.....|.....******************************.....
  .....******************************.....|.....******************************.....
  .....******************************.....|.....******************************.....
  .....******************************.....|.....******************************.....
  .....******************************.....|.....******************************.....
  .....******************************.....|.....******************************.....
  .....******************************.....|.....******************************.....
  .....******************************.....|.....******************************.....
  .....******************************.....|.....******************************.....
  .....******************************.....|.....******************************.....
  .....******************************.....|.....******************************.....
  .....******************************.....|.....******************************.....
  .....******************************.....|.....******************************.....
  ........................................|........................................
  ....4...................................|...................................1....
  ........................................|........................................
  ........................................|........................................
  ---------------------------------------------------------------------------------
  ........................................|........................................
  ................bcksp.es................|..............Introduction..............
  ........................................|........................................
  .....******************************.....|.....******************************.....
  .....******************************.....|.....******************************.....
  .....******************************.....|.....******************************.....
  .....******************************.....|.....******************************.....
  .....******************************.....|.....******************************.....
  .....******************************.....|.....******************************.....
  .....******************************.....|.....******************************.....
  .....******************************.....|.....******************************.....
  .....******************************.....|.....******************************.....
  .....******************************.....|.....******************************.....
  .....******************************.....|.....******************************.....
  .....******************************.....|.....******************************.....
  .....******************************.....|.....******************************.....
  .....******************************.....|.....******************************.....
  .....******************************.....|.....******************************.....
  .....******************************.....|.....******************************.....
  .....******************************.....|.....******************************.....
  .....******************************.....|.....******************************.....
  .....******************************.....|.....******************************.....
  .....******************************.....|.....******************************.....
  .....******************************.....|.....******************************.....
  .....******************************.....|.....******************************.....
  .....******************************.....|.....******************************.....
  .....******************************.....|.....******************************.....
  .....******************************.....|.....******************************.....
  .....******************************.....|.....******************************.....
  .....******************************.....|.....******************************.....
  .....******************************.....|.....******************************.....
  ........................................|........................................
  ....8...................................|...................................5....
  ........................................|........................................
  ........................................|........................................

  VERSO
  ........................................|........................................
  ................bcksp.es................|..............Introduction..............
  ........................................|........................................
  .....******************************.....|.....******************************.....
  .....******************************.....|.....******************************.....
  .....******************************.....|.....******************************.....
  .....******************************.....|.....******************************.....
  .....******************************.....|.....******************************.....
  .....******************************.....|.....******************************.....
  .....******************************.....|.....******************************.....
  .....******************************.....|.....******************************.....
  .....******************************.....|.....******************************.....
  .....******************************.....|.....******************************.....
  .....******************************.....|.....******************************.....
  .....******************************.....|.....******************************.....
  .....******************************.....|.....******************************.....
  .....******************************.....|.....******************************.....
  .....******************************.....|.....******************************.....
  .....******************************.....|.....******************************.....
  .....******************************.....|.....******************************.....
  .....******************************.....|.....******************************.....
  .....******************************.....|.....******************************.....
  .....******************************.....|.....******************************.....
  .....******************************.....|.....******************************.....
  .....******************************.....|.....******************************.....
  .....******************************.....|.....******************************.....
  .....******************************.....|.....******************************.....
  .....******************************.....|.....******************************.....
  .....******************************.....|.....******************************.....
  .....******************************.....|.....******************************.....
  .....******************************.....|.....******************************.....
  ........................................|........................................
  ....2...................................|...................................3....
  ........................................|........................................
  ........................................|........................................
  ---------------------------------------------------------------------------------
  ........................................|........................................
  ................bcksp.es................|..............Introduction..............
  ........................................|........................................
  .....******************************.....|.....******************************.....
  .....******************************.....|.....******************************.....
  .....******************************.....|.....******************************.....
  .....******************************.....|.....******************************.....
  .....******************************.....|.....******************************.....
  .....******************************.....|.....******************************.....
  .....******************************.....|.....******************************.....
  .....******************************.....|.....******************************.....
  .....******************************.....|.....******************************.....
  .....******************************.....|.....******************************.....
  .....******************************.....|.....******************************.....
  .....******************************.....|.....******************************.....
  .....******************************.....|.....******************************.....
  .....******************************.....|.....******************************.....
  .....******************************.....|.....******************************.....
  .....******************************.....|.....******************************.....
  .....******************************.....|.....******************************.....
  .....******************************.....|.....******************************.....
  .....******************************.....|.....******************************.....
  .....******************************.....|.....******************************.....
  .....******************************.....|.....******************************.....
  .....******************************.....|.....******************************.....
  .....******************************.....|.....******************************.....
  .....******************************.....|.....******************************.....
  .....******************************.....|.....******************************.....
  .....******************************.....|.....******************************.....
  .....******************************.....|.....******************************.....
  .....******************************.....|.....******************************.....
  ........................................|........................................
  ....6...................................|...................................7....
  ........................................|........................................
  ........................................|........................................

    1 : RECTO | TOP    | RIGHT
    2 : VERSO | TOP    | LEFT
    3 : VERSO | TOP    | RIGHT
    4 : RECTO | TOP    | LEFT
    5 : RECTO | BOTTOM | LEFT
    6 : VERSO | BOTTOM | RIGHT
    7 : VERSO | BOTTOM | LEFT
    8 : RECTO | BOTTOM | RIGHT

*/




// STEPPER CONTROLLER
#include <Stepper.h>
#define  STEPS                     48
#define  STEPPER_PIN_0             28
#define  STEPPER_PIN_1             26
#define  STEPPER_PIN_2             24
#define  STEPPER_PIN_3             22
#define  SETP_BY_LINE              62
#define  STEPPER_SPEED             300
Stepper stepper(STEPS, STEPPER_PIN_0, STEPPER_PIN_1, STEPPER_PIN_2, STEPPER_PIN_3);


// PUBLISHING SETTING

#define  SWIDTH     80          // Sheet Width (char)
#define  SHEIGHT    70          // Sheet Height(char)
#define  PWIDTH     SWIDTH/2    // Page Width  (char)
#define  PHEIGHT    SHEIGHT/2   // Page Height (char)

#define  MCPL       30       // Maximum Characters Per Line
#define  MLPP       28       // Maximum Line Per Page
#define  MT         3
#define  MB         4
#define  ML         5
#define  MR         5

#define  FOLIO_MT   1
#define  FOLIO_ML   4   folio <= 9 : 4
                        folio >= 10 : 3

#define  MR         5        // Margin Right
#define  MT         1        // Margin Top
#define  MB         3        // Margin Bottom
int      ML       = 5; // 46 // Margin Left
int      CPLCnt   = 0;       // Character Per Line Counter
int      LCnt     = 0;       // Line Counter
int      FOLIOCnt = 1; 
String   FOLIO    = "prout";
int      FOLIOML  = 2;




// PRINTER COMMAND
byte RESET       [] = { 
  27, 'E' };           // ESC + E

byte RINGTHEBELL [] = { 
  7 };                 // BEL

byte NEWLINE     [] = { 
  10, 13 };            // LF + CR

byte NEWPAGE     [] = { 
  12, 13 };            // FF + CR

// PARALLEL PORT TO ARDUINO PIN
#define  nStrobe    2
#define  data_0     3
#define  data_1     4
#define  data_2     5
#define  data_3     6
#define  data_4     7
#define  data_5     8
#define  data_6     9
#define  data_7     10
#define  nAck       11
#define  busy       12
// MICROSECONDS TO STROBE FOR
#define  strobeWait 2

void setup() {
  // STEPPER INIT
  stepper.setSpeed(STEPPER_SPEED);

  Serial.begin(9600);
  while (!Serial) {
    ; // wait for serial port to connect. Needed for Leonardo only
  }

  pinMode(nStrobe, OUTPUT);      // is active LOW
  digitalWrite(nStrobe, HIGH);   // set HIGH
  pinMode(data_0, OUTPUT);
  pinMode(data_1, OUTPUT);
  pinMode(data_2, OUTPUT);
  pinMode(data_3, OUTPUT);
  pinMode(data_4, OUTPUT);
  pinMode(data_5, OUTPUT);
  pinMode(data_6, OUTPUT);
  pinMode(data_7, OUTPUT);
  pinMode(nAck, INPUT);     // is active LOW
  pinMode(busy, INPUT);  

  delay(1000);
  CMD(RESET);
  CMD(RINGTHEBELL);
}

void loop() {
  if(Serial.available()){
    byte message  = Serial.read();
    CMD(RESET);
    int result = printMessage(message);
    CMD(RESET);
    switch(result){
    case 0:
      break;
    case 1:
      CMD(NEWLINE);
      LCnt ++;
      delay(10);
      CPLCnt = 0;
      Serial.println("");
      break;
    case 2:
      CMD(RESET);
      printFolio(String(FOLIOCnt++));
      CMD(RESET);
      if(ML == 5){
        CMD(NEWLINE);
        LCnt ++;
        delay(1000);
        backline();
        ML = (ML + MCPL + MR) + ML;
        FOLIOML = (ML + MCPL + MR) + (ML + MCPL + MR) - FOLIOML;
        LCnt = 0;
        CPLCnt = 0;
      }
      else{
        CMD(RESET);
        CMD(NEWPAGE);
        CMD(RESET);
        ML = 5;
        FOLIOML = 2;
        LCnt = 0;
        CPLCnt = 0;
      }
      break;
    }
  }
}

void CMD(byte CMD []){
  for(int i = 0 ; i < sizeof(CMD) ; i++){
    printByte(CMD[i]);
  }
}

void printByte(byte inByte) {
  while(digitalRead(busy) == HIGH);

  digitalWrite(data_0, bitRead(inByte, 0));
  digitalWrite(data_1, bitRead(inByte, 1));
  digitalWrite(data_2, bitRead(inByte, 2));
  digitalWrite(data_3, bitRead(inByte, 3));
  digitalWrite(data_4, bitRead(inByte, 4));
  digitalWrite(data_5, bitRead(inByte, 5));
  digitalWrite(data_6, bitRead(inByte, 6));
  digitalWrite(data_7, bitRead(inByte, 7));

  digitalWrite(nStrobe, LOW);       // strobe nStrobe to input data bits
  delayMicroseconds(strobeWait);
  digitalWrite(nStrobe, HIGH);

  while(digitalRead(busy) == HIGH);
}

// return 
// '0' => Nothing
// '1' => End Line
// '2' => End Page
int printMessage(byte message) {
  // MARGIN TOP
  while(LCnt < MT){
    CMD(NEWLINE);
    LCnt ++;
    Serial.println('*');
  }
  // MARGIN LEFT
  while(CPLCnt < ML){
    printByte(' ');
    CPLCnt ++;
    Serial.print('.');
  }
  if( message != LF){
    printByte(message);
    Serial.print(char(message));
    CPLCnt ++;

  }

  // if line complete || if End Line
  if(CPLCnt >= MCPL+ML || message == LF){
    // if page complete
    if(LCnt >= MLPP+MT){
      return 2;
    }
    return 1;
  }
  return 0;
}

void printFolio(String folio) {
  for(int i = 0 ; i < FOLIOMT ; i ++){
    CMD(NEWLINE);
    LCnt ++;
    Serial.println('*');
  }
  // MARGIN LEFT
  for(int i = 0 ; i < FOLIOML ; i ++){
    printByte(' ');
    Serial.print('.');
  }
  for(int i = 0 ; i < folio.length() ; i++){
    printByte(folio[i]);
    Serial.print(char(folio[i]));
  }
  Serial.println("");
  CMD(NEWLINE);
  LCnt ++;
}

void backline(){
  stepper.step(SETP_BY_LINE * (LCnt - 1) );
  delay(5000);
  Serial.println("LOW");
  digitalWrite(STEPPER_PIN_0, LOW);
  digitalWrite(STEPPER_PIN_1, LOW);
  digitalWrite(STEPPER_PIN_2, LOW);
  digitalWrite(STEPPER_PIN_3, LOW);
}

void frontline(){
  stepper.step( - SETP_BY_LINE * (SHEIGHT/2) );
  delay(5000);
  Serial.println("LOW");
  digitalWrite(STEPPER_PIN_0, LOW);
  digitalWrite(STEPPER_PIN_1, LOW);
  digitalWrite(STEPPER_PIN_2, LOW);
  digitalWrite(STEPPER_PIN_3, LOW);
}







